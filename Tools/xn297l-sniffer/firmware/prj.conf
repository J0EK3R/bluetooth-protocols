## CMakeLists.txt
```
# SPDX-License-Identifier: Apache-2.0
#
# XN297L sniffer firmware for the nRF52840 MDK USB Dongle.
# Build:  west build -b nrf52840_mdk_usb_dongle firmware
#
# The application is a plain Zephyr application without Bluetooth stack:
# the RADIO peripheral is programmed directly as a raw 1 Mbps GFSK receiver.

cmake_minimum_required(VERSION 3.20.0)

# Pull in Zephyr (ZEPHYR_BASE is set by west or the nRF Connect SDK)
find_package(Zephyr REQUIRED HINTS $ENV{ZEPHYR_BASE})

project(xn297l_sniffer)

# Application sources
target_sources(app PRIVATE
    src/main.c      # command parser, main loop, USB CDC output
    src/radio.c     # raw RADIO configuration and packet reception
)
```

## prj.conf
```kconfig
# --- USB CDC ACM (virtual COM port) -----------------------------------------
# The dongle shows up as a serial port; all commands and packet reports
# are exchanged as text lines over this port.
CONFIG_USB_DEVICE_STACK=y
CONFIG_USB_DEVICE_MANUFACTURER="bluetooth-protocols"
CONFIG_USB_DEVICE_PRODUCT="XN297L Sniffer"
# USB is enabled from main() (usb_enable), not automatically at boot
CONFIG_USB_DEVICE_INITIALIZE_AT_BOOT=n
CONFIG_SERIAL=y
CONFIG_UART_INTERRUPT_DRIVEN=y
# Needed to read the DTR line (only send data while a host has the port open)
CONFIG_UART_LINE_CTRL=y

# --- No Bluetooth stack: the RADIO is driven directly ------------------------
CONFIG_BT=n

# --- LEDs ---------------------------------------------------------------------
CONFIG_GPIO=y

# --- Keep the USB/UART path quiet (no log output mixed into the data stream) --
CONFIG_LOG=n
CONFIG_UART_CONSOLE=n
CONFIG_CONSOLE=n

# --- Output format for the UF2 bootloader (drag & drop flashing) -------------
# The board links the application at 0x1000 (after the Nordic MBR), which is
# where the factory UF2 bootloader of the dongle expects it.
CONFIG_BUILD_OUTPUT_UF2=y
CONFIG_BUILD_OUTPUT_UF2_FAMILY_ID="0xADA52840"

# --- Stack sizes ---------------------------------------------------------------
CONFIG_MAIN_STACK_SIZE=2048
```

## boards/nrf52840_mdk_usb_dongle.overlay
```dts
/*
 * Board overlay for the nRF52840 MDK USB Dongle.
 *
 * Adds a CDC ACM UART instance on the USB device controller.
 * The firmware talks to the host exclusively through this virtual COM port.
 */

&zephyr_udc0 {
	cdc_acm_uart0: cdc_acm_uart0 {
		compatible = "zephyr,cdc-acm-uart";
	};
};
```

## src/main.c
```c
/*
 * XN297L sniffer firmware for the nRF52840 MDK USB Dongle.
 *
 * The dongle enumerates as a USB CDC ACM device (virtual COM port).
 * Communication is line based ASCII, terminated by '\n' ('\r' is ignored).
 *
 * Commands (host -> dongle)
 * -------------------------
 *   help                 list commands
 *   info                 print the current configuration
 *   sync <hex>           sync word, 3..5 bytes, on-air order, MSB first
 *                        e.g. "sync 710F55" or "sync 2675882844"
 *   len <n>              number of bytes captured after the sync word (1..250)
 *   ch <list>            RF channel list, channel = MHz - 2400 (0..100),
 *                        single channels and ranges, e.g. "23", "2,26,80",
 *                        "0-83" (all channels), "10-20,40"; max. 84 entries
 *   dwell <ms>           time per channel when hopping, 0 = stay on first
 *   rate <r>             nrf1m (default) | ble1m | nrf2m
 *   start                start receiving
 *   stop                 stop receiving
 *
 * Responses (dongle -> host)
 * --------------------------
 *   OK                   command accepted
 *   E <text>             error
 *   I <key>=<value> ...  information
 *   P <t_us> <ch> <rssi> <hex>
 *                        received packet: device time in microseconds,
 *                        RF channel, RSSI in dBm, sync word + captured bytes
 *                        as hex (on-air order, MSB first)
 *
 * Data is only sent while the host has the port open (DTR asserted).
 *
 * SPDX-License-Identifier: Apache-2.0
 */

#include <stdbool.h>
#include <stdint.h>
#include <string.h>

#include <zephyr/kernel.h>
#include <zephyr/device.h>
#include <zephyr/drivers/gpio.h>
#include <zephyr/drivers/uart.h>
#include <zephyr/usb/usb_device.h>

#include "radio.h"

#define FW_VERSION "1.1.0"

/* ------------------------------------------------------------------------ */
/* Devices                                                                   */
/* ------------------------------------------------------------------------ */

/* CDC ACM UART defined in boards/nrf52840_mdk_usb_dongle.overlay */
static const struct device *const cdc_dev = DEVICE_DT_GET(DT_NODELABEL(cdc_acm_uart0));

/* RGB LED of the dongle (active low, handled by the GPIO flags) */
static const struct gpio_dt_spec led_red   = GPIO_DT_SPEC_GET(DT_NODELABEL(led0_red), gpios);
static const struct gpio_dt_spec led_green = GPIO_DT_SPEC_GET(DT_NODELABEL(led0_green), gpios);
static const struct gpio_dt_spec led_blue  = GPIO_DT_SPEC_GET(DT_NODELABEL(led0_blue), gpios);

/* ------------------------------------------------------------------------ */
/* State                                                                     */
/* ------------------------------------------------------------------------ */

/*
 * Default configuration: promiscuous XN297L mode.
 *   sync = XN297L preamble 71 0F 55
 *   len  = 5 address + 32 payload + 2 CRC = 39 bytes
 *   channels 2402, 2426, 2480 MHz (the BLE advertising frequencies)
 */
static struct radio_config cfg = {
	.sync = { 0x71, 0x0F, 0x55 },
	.sync_len = 3,
	.capture_len = 39,
	.channels = { 2, 26, 80 },
	.channel_count = 3,
	.dwell_ms = 300,
	.rate = RADIO_RATE_NRF_1M,
};

static bool running;            /* receiver active                      */
static bool host_connected;     /* DTR asserted by the host             */
static int64_t green_off_ms;    /* time to switch the packet LED off    */

/* Command line buffer */
static char line[128];
static size_t line_len;

/* ------------------------------------------------------------------------ */
/* Output helpers (no printf: keeps the image small and the output exact)    */
/* ------------------------------------------------------------------------ */

/* Send a string to the host (dropped if no host has the port open). */
static void out_str(const char *s)
{
	if (!host_connected) {
		return;
	}
	while (*s != '\0') {
		uart_poll_out(cdc_dev, (unsigned char)*s++);
	}
}

/* Send an unsigned decimal number. */
static void out_u32(uint32_t v)
{
	char buf[11];
	int i = (int)sizeof(buf) - 1;

	buf[i] = '\0';
	do {
		buf[--i] = (char)('0' + (v % 10u));
		v /= 10u;
	} while (v != 0u && i > 0);
	out_str(&buf[i]);
}

/* Send a signed decimal number. */
static void out_i32(int32_t v)
{
	if (v < 0) {
		out_str("-");
		out_u32((uint32_t)(-v));
	} else {
		out_u32((uint32_t)v);
	}
}

/* Send bytes as upper case hex without separators. */
static void out_hex(const uint8_t *data, size_t len)
{
	static const char digits[] = "0123456789ABCDEF";
	char pair[3] = { 0, 0, 0 };

	for (size_t i = 0; i < len; i++) {
		pair[0] = digits[data[i] >> 4];
		pair[1] = digits[data[i] & 0x0Fu];
		out_str(pair);
	}
}

/* ------------------------------------------------------------------------ */
/* Parsing helpers                                                           */
/* ------------------------------------------------------------------------ */

/* Convert one hex digit, returns -1 on error. */
static int hex_digit(char c)
{
	if (c >= '0' && c <= '9') {
		return c - '0';
	}
	if (c >= 'a' && c <= 'f') {
		return c - 'a' + 10;
	}
	if (c >= 'A' && c <= 'F') {
		return c - 'A' + 10;
	}
	return -1;
}

/*
 * Parse a hex string ("710F55", spaces/colons allowed) into out[].
 * Returns the number of bytes or -1 on error.
 */
static int parse_hex(const char *s, uint8_t *out, size_t max)
{
	size_t n = 0;
	int hi = -1;

	for (; *s != '\0'; s++) {
		if (*s == ' ' || *s == ':' || *s == '-') {
			continue;
		}
		int d = hex_digit(*s);

		if (d < 0) {
			return -1;
		}
		if (hi < 0) {
			hi = d;
		} else {
			if (n >= max) {
				return -1;
			}
			out[n++] = (uint8_t)(hi << 4 | d);
			hi = -1;
		}
	}
	return (hi < 0) ? (int)n : -1;   /* odd number of digits = error */
}

/* Parse an unsigned decimal number, advancing *s. Returns false on error. */
static bool parse_uint(const char **s, uint32_t *value)
{
	uint32_t v = 0;
	const char *p = *s;

	if (*p < '0' || *p > '9') {
		return false;
	}
	while (*p >= '0' && *p <= '9') {
		v = v * 10u + (uint32_t)(*p - '0');
		if (v > 100000u) {
			return false;
		}
		p++;
	}
	*s = p;
	*value = v;
	return true;
}

/* ------------------------------------------------------------------------ */
/* Commands                                                                  */
/* ------------------------------------------------------------------------ */

static const char *rate_name(enum radio_rate r)
{
	switch (r) {
	case RADIO_RATE_NRF_2M:
		return "nrf2m";
	case RADIO_RATE_BLE_1M:
		return "ble1m";
	default:
		return "nrf1m";
	}
}

/* Print the configuration as one "I" line. */
static void print_info(void)
{
	out_str("I version=" FW_VERSION " sync=");
	out_hex(cfg.sync, cfg.sync_len);
	out_str(" len=");
	out_u32(cfg.capture_len);
	out_str(" ch=");
	for (uint8_t i = 0; i < cfg.channel_count; i++) {
		if (i != 0u) {
			out_str(",");
		}
		out_u32(cfg.channels[i]);
	}
	out_str(" dwell=");
	out_u32(cfg.dwell_ms);
	out_str(" rate=");
	out_str(rate_name(cfg.rate));
	out_str(running ? " state=running\n" : " state=stopped\n");
}

/* Update the status LEDs: blue = running, red = stopped. */
static void update_state_leds(void)
{
	gpio_pin_set_dt(&led_blue, running ? 1 : 0);
	gpio_pin_set_dt(&led_red, running ? 0 : 1);
}

/* Restart the receiver with the new configuration if it is running. */
static void apply_config(void)
{
	if (running) {
		radio_start(&cfg);
	}
}

/* Execute one command line. */
static void handle_command(char *cmd)
{
	/* Split "keyword argument" */
	char *arg = strchr(cmd, ' ');

	if (arg != NULL) {
		*arg++ = '\0';
		while (*arg == ' ') {
			arg++;
		}
	} else {
		arg = cmd + strlen(cmd);   /* empty argument */
	}

	if (cmd[0] == '\0') {
		return;                    /* empty line: ignore silently */
	}

	if (strcmp(cmd, "help") == 0) {
		out_str("I commands: help info start stop sync <hex> len <n> "
			"ch <list, e.g. 2,26,80 or 0-83> dwell <ms> rate <nrf1m|ble1m|nrf2m>\n");
		out_str("OK\n");

	} else if (strcmp(cmd, "info") == 0) {
		print_info();
		out_str("OK\n");

	} else if (strcmp(cmd, "start") == 0) {
		running = true;
		radio_start(&cfg);
		update_state_leds();
		out_str("OK\n");

	} else if (strcmp(cmd, "stop") == 0) {
		running = false;
		radio_stop();
		update_state_leds();
		out_str("OK\n");

	} else if (strcmp(cmd, "sync") == 0) {
		uint8_t tmp[RADIO_SYNC_MAX];
		int n = parse_hex(arg, tmp, sizeof(tmp));

		if (n < (int)RADIO_SYNC_MIN || n > (int)RADIO_SYNC_MAX) {
			out_str("E sync must be 3..5 hex bytes\n");
			return;
		}
		memcpy(cfg.sync, tmp, (size_t)n);
		cfg.sync_len = (uint8_t)n;
		apply_config();
		out_str("OK\n");

	} else if (strcmp(cmd, "len") == 0) {
		const char *p = arg;
		uint32_t v;

		if (!parse_uint(&p, &v) || v < 1u || v > RADIO_LEN_MAX) {
			out_str("E len must be 1..250\n");
			return;
		}
		cfg.capture_len = (uint8_t)v;
		apply_config();
		out_str("OK\n");

	} else if (strcmp(cmd, "ch") == 0) {
		struct radio_config tmp = cfg;
		const char *p = arg;
		uint32_t first;
		uint32_t last;

		tmp.channel_count = 0;
		while (*p != '\0') {
			/* one entry: "n" or a range "n-m" */
			if (!parse_uint(&p, &first) || first > 100u) {
				out_str("E ch must be channels 0..100, e.g. 2,26,80 or 0-83\n");
				return;
			}
			last = first;
			if (*p == '-') {
				p++;
				if (!parse_uint(&p, &last) || last > 100u || last < first) {
					out_str("E ch range must be n-m with n <= m <= 100\n");
					return;
				}
			}
			for (uint32_t c = first; c <= last; c++) {
				if (tmp.channel_count >= RADIO_CHANNELS_MAX) {
					out_str("E ch list has more than 84 entries\n");
					return;
				}
				tmp.channels[tmp.channel_count++] = (uint8_t)c;
			}
			while (*p == ',' || *p == ' ') {
				p++;
			}
		}
		if (tmp.channel_count == 0u) {
			out_str("E ch needs at least one channel\n");
			return;
		}
		cfg = tmp;
		apply_config();
		out_str("OK\n");

	} else if (strcmp(cmd, "dwell") == 0) {
		const char *p = arg;
		uint32_t v;

		if (!parse_uint(&p, &v) || v > 60000u) {
			out_str("E dwell must be 0..60000 ms\n");
			return;
		}
		cfg.dwell_ms = (uint16_t)v;
		apply_config();
		out_str("OK\n");

	} else if (strcmp(cmd, "rate") == 0) {
		if (strcmp(arg, "nrf1m") == 0) {
			cfg.rate = RADIO_RATE_NRF_1M;
		} else if (strcmp(arg, "ble1m") == 0) {
			cfg.rate = RADIO_RATE_BLE_1M;
		} else if (strcmp(arg, "nrf2m") == 0) {
			cfg.rate = RADIO_RATE_NRF_2M;
		} else {
			out_str("E rate must be nrf1m, ble1m or nrf2m\n");
			return;
		}
		apply_config();
		out_str("OK\n");

	} else {
		out_str("E unknown command (try 'help')\n");
	}
}

/* Read all pending characters from the host and execute complete lines. */
static void poll_input(void)
{
	unsigned char c;

	while (uart_poll_in(cdc_dev, &c) == 0) {
		if (c == '\r') {
			continue;
		}
		if (c == '\n') {
			line[line_len] = '\0';
			handle_command(line);
			line_len = 0;
			continue;
		}
		if (line_len < sizeof(line) - 1u) {
			/* store lower case so commands are case-insensitive */
			line[line_len++] = (c >= 'A' && c <= 'Z') ? (char)(c + 32) : (char)c;
		}
	}
}

/* Track the DTR line: the host opened or closed the port. */
static void poll_dtr(void)
{
	uint32_t dtr = 0;

	if (uart_line_ctrl_get(cdc_dev, UART_LINE_CTRL_DTR, &dtr) != 0) {
		return;
	}

	if (dtr != 0u && !host_connected) {
		host_connected = true;
		line_len = 0;
		out_str("I XN297L sniffer ready\n");
		print_info();
	} else if (dtr == 0u && host_connected) {
		host_connected = false;
	}
}

/* Send one packet report line. */
static void report_packet(const struct radio_packet *pkt)
{
	out_str("P ");
	out_u32(pkt->timestamp_us);
	out_str(" ");
	out_u32(pkt->channel);
	out_str(" ");
	out_i32(pkt->rssi_dbm);
	out_str(" ");
	out_hex(cfg.sync, cfg.sync_len);   /* sync word first ...           */
	out_hex(pkt->data, pkt->len);      /* ... then the captured bytes   */
	out_str("\n");
}

/* ------------------------------------------------------------------------ */
/* Main                                                                      */
/* ------------------------------------------------------------------------ */

int main(void)
{
	static struct radio_packet pkt;   /* static: keep it off the stack */
	int64_t last_dtr_check = 0;

	/* LEDs */
	gpio_pin_configure_dt(&led_red, GPIO_OUTPUT_INACTIVE);
	gpio_pin_configure_dt(&led_green, GPIO_OUTPUT_INACTIVE);
	gpio_pin_configure_dt(&led_blue, GPIO_OUTPUT_INACTIVE);
	update_state_leds();

	/* The RADIO needs the HF crystal */
	if (radio_hfclk_start() != 0) {
		/* Without HFXO the RADIO cannot work: blink red forever */
		for (;;) {
			gpio_pin_toggle_dt(&led_red);
			k_msleep(200);
		}
	}

	/* USB CDC ACM */
	if (!device_is_ready(cdc_dev) || usb_enable(NULL) != 0) {
		for (;;) {
			gpio_pin_toggle_dt(&led_red);
			k_msleep(1000);
		}
	}

	for (;;) {
		/* Commands from the host */
		poll_input();

		/* Port opened/closed? (checked every 50 ms) */
		if (k_uptime_get() - last_dtr_check >= 50) {
			last_dtr_check = k_uptime_get();
			poll_dtr();
		}

		/* Received packets (drain everything that is available) */
		while (radio_poll(&pkt)) {
			report_packet(&pkt);
			gpio_pin_set_dt(&led_green, 1);
			green_off_ms = k_uptime_get() + 20;
		}

		/* Packet LED: short green flash */
		if (green_off_ms != 0 && k_uptime_get() >= green_off_ms) {
			gpio_pin_set_dt(&led_green, 0);
			green_off_ms = 0;
		}

		/*
		 * Give the USB stack time to run. While receiving, poll the
		 * RADIO roughly every 60 us (a 40 byte packet takes ~350 us
		 * at 1 Mbps); while stopped, a slower loop is fine.
		 */
		if (running) {
			k_usleep(50);
		} else {
			k_msleep(5);
		}
	}

	return 0;
}
```

## src/radio.c
```c
/*
 * Raw receiver on top of the nRF52840 RADIO peripheral.
 *
 * How an XN297L frame is received
 * -------------------------------
 * The XN297L sends (on-air order, MSB first):
 *
 *     71 0F 55 | address 3..5 B | payload | CRC 2 B
 *     preamble  \______ scrambled (if enabled) ______/
 *
 * The nRF52840 in "Nrf_1Mbit" mode expects:
 *
 *     preamble 1 B (0x55/0xAA) | address (BASE + PREFIX) | payload ...
 *
 * The last XN297L preamble byte 0x55 serves as the nRF preamble, and the
 * (scrambled) XN297L address is used as the nRF address. Everything after the
 * address is captured as raw payload with CRC and whitening disabled; the
 * host software descrambles and checks the XN297L CRC.
 *
 * Alternatively the sync word can be set to the XN297L preamble 71 0F 55
 * itself ("promiscuous" mode, address unknown). Then the address is part of
 * the captured bytes. This mode is experimental: the nRF expects an
 * alternating preamble in front of the sync word, which is not present.
 *
 * Bit order
 * ---------
 * The RADIO always transmits/receives the address LSB first, starting with the
 * least significant used byte of BASEn, followed by PREFIXn (this is how the
 * BLE access address 0x8E89BED6 ends up on air as D6 BE 89 8E, LSB first).
 * To match on-air bytes given MSB first, every byte is bit-reversed and placed
 * accordingly (see set_sync_word()).
 * The payload is received MSB first by setting PCNF1.ENDIAN = Big, so the
 * captured bytes are already in on-air MSB-first notation.
 *
 * SPDX-License-Identifier: Apache-2.0
 */

#include <string.h>

#include <zephyr/kernel.h>
#include <zephyr/drivers/clock_control.h>
#include <zephyr/drivers/clock_control/nrf_clock_control.h>
#include <soc.h>    /* NRF_RADIO and register bit definitions (nrfx MDK) */

#include "radio.h"

/* Active configuration (copied in radio_start()) */
static struct radio_config active_cfg;

/* Index into active_cfg.channels[] and time of the last hop */
static uint8_t channel_index;
static int64_t last_hop_ms;

/* Receive buffer the RADIO writes into via EasyDMA (must be in RAM) */
static uint8_t rx_buffer[RADIO_LEN_MAX + 1];

/* True while the receiver is running */
static bool running;

/* ------------------------------------------------------------------------ */
/* Helpers                                                                   */
/* ------------------------------------------------------------------------ */

/* Reverse the bit order of one byte (0b00000001 -> 0b10000000). */
static uint8_t rev8(uint8_t b)
{
	b = (uint8_t)((b & 0xF0u) >> 4 | (b & 0x0Fu) << 4);
	b = (uint8_t)((b & 0xCCu) >> 2 | (b & 0x33u) << 2);
	b = (uint8_t)((b & 0xAAu) >> 1 | (b & 0x55u) << 1);
	return b;
}

/* Disable the RADIO and wait until it is really disabled. */
static void radio_disable_and_wait(void)
{
	NRF_RADIO->SHORTS = 0;
	NRF_RADIO->EVENTS_DISABLED = 0;
	NRF_RADIO->TASKS_DISABLE = 1;
	while (NRF_RADIO->EVENTS_DISABLED == 0) {
		/* busy wait, takes only a few microseconds */
	}
	NRF_RADIO->EVENTS_DISABLED = 0;
}

/*
 * Program BASE0/PREFIX0 so that the RADIO matches the given on-air bytes.
 *
 * sync[0] is the first byte on air, given MSB first. With n bytes:
 *   - the first n-1 bytes go to BASE0 (BALEN = n-1),
 *   - the last byte goes to PREFIX0 (AP0).
 *
 * BASE0 uses its most significant BALEN bytes; on air the least significant
 * of those comes first. Example for BALEN = 3 (same layout as BLE):
 *   BASE0 = rev8(s0) << 8 | rev8(s1) << 16 | rev8(s2) << 24, PREFIX0 = rev8(s3)
 */
static void set_sync_word(const uint8_t *sync, uint8_t n)
{
	uint8_t balen = (uint8_t)(n - 1u);
	uint32_t base = 0;

	for (uint8_t i = 0; i < balen; i++) {
		/* byte i of the base address goes to bit position 8 * (4 - balen + i) */
		base |= (uint32_t)rev8(sync[i]) << (8u * (4u - balen + i));
	}

	NRF_RADIO->BASE0 = base;
	NRF_RADIO->PREFIX0 = rev8(sync[n - 1u]);   /* AP0 = bits 7:0 */
	NRF_RADIO->RXADDRESSES = 1u;                /* only logical address 0 */
}

/* Tune to the channel at channel_index and (re)start the receiver. */
static void start_rx_on_current_channel(void)
{
	radio_disable_and_wait();

	NRF_RADIO->FREQUENCY = active_cfg.channels[channel_index];

	/*
	 * Shortcuts:
	 *   READY   -> START     : start receiving as soon as RX is ramped up
	 *   ADDRESS -> RSSISTART : sample RSSI right after the sync word matched
	 *   DISABLED-> RSSISTOP  : stop RSSI measurement when disabled
	 */
	NRF_RADIO->SHORTS = RADIO_SHORTS_READY_START_Msk |
			    RADIO_SHORTS_ADDRESS_RSSISTART_Msk |
			    RADIO_SHORTS_DISABLED_RSSISTOP_Msk;

	NRF_RADIO->EVENTS_READY = 0;
	NRF_RADIO->EVENTS_ADDRESS = 0;
	NRF_RADIO->EVENTS_END = 0;
	NRF_RADIO->TASKS_RXEN = 1;

	last_hop_ms = k_uptime_get();
}

/* ------------------------------------------------------------------------ */
/* Public API                                                                */
/* ------------------------------------------------------------------------ */

int radio_hfclk_start(void)
{
	/*
	 * The RADIO needs the external 32 MHz crystal (HFXO). Request it through
	 * the Zephyr clock control driver so it stays on together with USB.
	 */
	struct onoff_manager *mgr =
		z_nrf_clock_control_get_onoff(CLOCK_CONTROL_NRF_SUBSYS_HF);
	struct onoff_client cli;
	int res = 0;
	int err;

	if (mgr == NULL) {
		return -ENXIO;
	}

	sys_notify_init_spinwait(&cli.notify);
	err = onoff_request(mgr, &cli);
	if (err < 0) {
		return err;
	}

	/* Wait until the crystal is running */
	do {
		err = sys_notify_fetch_result(&cli.notify, &res);
	} while (err == -EAGAIN);

	return (err < 0) ? err : res;
}

void radio_start(const struct radio_config *cfg)
{
	active_cfg = *cfg;
	channel_index = 0;

	radio_disable_and_wait();

	/* --- Data rate / modulation ------------------------------------------ */
	switch (active_cfg.rate) {
	case RADIO_RATE_NRF_2M:
		NRF_RADIO->MODE = RADIO_MODE_MODE_Nrf_2Mbit << RADIO_MODE_MODE_Pos;
		break;
	case RADIO_RATE_BLE_1M:
		NRF_RADIO->MODE = RADIO_MODE_MODE_Ble_1Mbit << RADIO_MODE_MODE_Pos;
		break;
	case RADIO_RATE_NRF_1M:
	default:
		NRF_RADIO->MODE = RADIO_MODE_MODE_Nrf_1Mbit << RADIO_MODE_MODE_Pos;
		break;
	}

	/*
	 * --- Packet layout ---------------------------------------------------
	 * PCNF0: no LENGTH, S0 or S1 field, 8-bit preamble.
	 */
	NRF_RADIO->PCNF0 = (0u << RADIO_PCNF0_LFLEN_Pos) |
			   (0u << RADIO_PCNF0_S0LEN_Pos) |
			   (0u << RADIO_PCNF0_S1LEN_Pos) |
			   (RADIO_PCNF0_PLEN_8bit << RADIO_PCNF0_PLEN_Pos);

	/*
	 * PCNF1: static payload length = capture_len, base address length =
	 * sync_len - 1, payload MSB first (ENDIAN = Big), whitening off.
	 */
	NRF_RADIO->PCNF1 =
		((uint32_t)active_cfg.capture_len << RADIO_PCNF1_MAXLEN_Pos) |
		((uint32_t)active_cfg.capture_len << RADIO_PCNF1_STATLEN_Pos) |
		((uint32_t)(active_cfg.sync_len - 1u) << RADIO_PCNF1_BALEN_Pos) |
		(RADIO_PCNF1_ENDIAN_Big << RADIO_PCNF1_ENDIAN_Pos) |
		(RADIO_PCNF1_WHITEEN_Disabled << RADIO_PCNF1_WHITEEN_Pos);

	/* --- Sync word (address) --------------------------------------------- */
	set_sync_word(active_cfg.sync, active_cfg.sync_len);

	/* --- No hardware CRC: the XN297L CRC is checked on the host ---------- */
	NRF_RADIO->CRCCNF = RADIO_CRCCNF_LEN_Disabled << RADIO_CRCCNF_LEN_Pos;

	/* --- Receive buffer --------------------------------------------------- */
	NRF_RADIO->PACKETPTR = (uint32_t)rx_buffer;

	running = true;
	start_rx_on_current_channel();
}

void radio_stop(void)
{
	running = false;
	radio_disable_and_wait();
}

uint8_t radio_current_channel(void)
{
	return active_cfg.channels[channel_index];
}

bool radio_poll(struct radio_packet *pkt)
{
	if (!running) {
		return false;
	}

	/* --- Packet received? ------------------------------------------------- */
	if (NRF_RADIO->EVENTS_END != 0) {
		NRF_RADIO->EVENTS_END = 0;

		/* Copy the packet before re-arming the receiver */
		pkt->timestamp_us = (uint32_t)k_ticks_to_us_floor64(k_uptime_ticks());
		pkt->channel = active_cfg.channels[channel_index];
		pkt->rssi_dbm = (int8_t)(-(int)NRF_RADIO->RSSISAMPLE);
		pkt->len = active_cfg.capture_len;
		memcpy(pkt->data, rx_buffer, active_cfg.capture_len);

		/* After END the RADIO is in RXIDLE: start the next reception */
		NRF_RADIO->EVENTS_ADDRESS = 0;
		NRF_RADIO->TASKS_START = 1;
		return true;
	}

	/* --- Channel hopping -------------------------------------------------- */
	if (active_cfg.dwell_ms != 0u && active_cfg.channel_count > 1u &&
	    (k_uptime_get() - last_hop_ms) >= active_cfg.dwell_ms) {
		/*
		 * Do not hop in the middle of a packet: if the sync word has
		 * already matched (ADDRESS event), wait for END first.
		 */
		if (NRF_RADIO->EVENTS_ADDRESS == 0) {
			channel_index = (uint8_t)((channel_index + 1u) %
						  active_cfg.channel_count);
			start_rx_on_current_channel();
		}
	}

	return false;
}
```

## src/radio.h
```c
/*
 * Raw receiver on top of the nRF52840 RADIO peripheral.
 *
 * The RADIO is used as a "dumb" GFSK receiver:
 *   - it synchronises on a configurable sync word (3 ... 5 bytes),
 *   - hardware CRC and hardware whitening are switched off,
 *   - a fixed number of bytes following the sync word is captured.
 *
 * All byte values in this API are given in ON-AIR ORDER, MSB FIRST, i.e. the
 * order in which the bits leave the antenna of the transmitter. This is the
 * same notation as used in Chips/XN297L.md ("on-air form").
 *
 * SPDX-License-Identifier: Apache-2.0
 */

#ifndef RADIO_H_
#define RADIO_H_

#include <stdbool.h>
#include <stdint.h>

/* Limits */
#define RADIO_SYNC_MIN      3u      /* BALEN 2 + 1 prefix byte              */
#define RADIO_SYNC_MAX      5u      /* BALEN 4 + 1 prefix byte              */
#define RADIO_LEN_MAX       250u    /* bytes captured after the sync word  */
#define RADIO_CHANNELS_MAX  84u     /* entries in the hopping list (0 ... 83 = all channels) */

/* Supported on-air data rates / modulation settings */
enum radio_rate {
	RADIO_RATE_NRF_1M = 0,  /* Nordic proprietary 1 Mbps (deviation ~170 kHz) */
	RADIO_RATE_NRF_2M = 1,  /* Nordic proprietary 2 Mbps (old XN297 only)     */
	RADIO_RATE_BLE_1M = 2,  /* BLE 1M PHY (deviation ~250 kHz)                */
};

/* Receiver configuration */
struct radio_config {
	uint8_t sync[RADIO_SYNC_MAX];   /* sync word, on-air order, MSB first  */
	uint8_t sync_len;               /* 3 ... 5                              */
	uint8_t capture_len;            /* bytes captured after the sync word   */
	uint8_t channels[RADIO_CHANNELS_MAX]; /* RF channel = MHz - 2400        */
	uint8_t channel_count;          /* 1 ... RADIO_CHANNELS_MAX            */
	uint16_t dwell_ms;              /* time per channel, 0 = no hopping     */
	enum radio_rate rate;
};

/* One received packet */
struct radio_packet {
	uint32_t timestamp_us;          /* device uptime when the packet ended  */
	uint8_t channel;                /* RF channel (MHz - 2400)              */
	int8_t rssi_dbm;                /* RSSI sampled after the sync word     */
	uint8_t len;                    /* number of bytes in data[]            */
	uint8_t data[RADIO_LEN_MAX];    /* captured bytes, on-air order, MSB first */
};

/* Start the high-frequency crystal oscillator (required by the RADIO). */
int radio_hfclk_start(void);

/* Apply a configuration and start receiving on the first channel. */
void radio_start(const struct radio_config *cfg);

/* Stop receiving and disable the RADIO. */
void radio_stop(void);

/*
 * Poll the RADIO. Must be called frequently from the main loop.
 * Handles channel hopping and returns true if a packet was received
 * (copied to *pkt). The receiver is re-armed automatically.
 */
bool radio_poll(struct radio_packet *pkt);

/* Currently selected RF channel (MHz - 2400). */
uint8_t radio_current_channel(void);

#endif /* RADIO_H_ */
```
